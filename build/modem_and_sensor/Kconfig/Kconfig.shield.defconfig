## build/modem_and_sensor/Kconfig/Kconfig.shield.defconfig
```kconfig
osource "C:/ncs/my_boards/boards/shields/*/Kconfig.defconfig"
osource "C:/ncs/modem_and_sensor/boards/shields/*/Kconfig.defconfig"
osource "C:/ncs/v2.7.0/nrf/boards/shields/*/Kconfig.defconfig"
```
